#include "talkie.h"

// Initialization of voice codes and objects
const uint8_t spZERO[] PROGMEM = {0x69, 0xFB, 0x59, 0xDD, 0x51, 0xD5, 0xD7, 0xB5, 0x6F, 0x0A, 0x78, 0xC0, 0x52,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 0xFF, 0x1F};
const uint8_t spONE[] PROGMEM = {0x66, 0x4E, 0xA8, 0x7A, 0x8D, 0xED, 0xC4, 0xB5, 0xCD, 0x89, 0xD4, 0xBC, 0xA2,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 0xFE, 0x1F};
const uint8_t spTWO[]  PROGMEM = {0x06, 0xB8, 0x59, 0x34, 0x00, 0x27, 0xD6, 0x38, 0x60, 0x58, 0xD3, 0x91, 0x55,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 0xFF, 0x1F};
const uint8_t spTHREE[] PROGMEM = {0x0C, 0xE8, 0x2E, 0x94, 0x01, 0x4D, 0xBA, 0x4A, 0x40, 0x03, 0x16, 0x68, 0x69,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 0xFF, 0x03};
const uint8_t spFOUR[] PROGMEM = {0x08, 0x68, 0x21, 0x0D, 0x03, 0x1C, 0x90, 0xC0, 0x88, 0x92, 0xB2, 0x29, 0x87,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 0xFC, 0x3F};
const uint8_t spFIVE[] PROGMEM = {0x08, 0x68, 0x4E, 0x9D, 0x02, 0x1C, 0x60, 0xC0, 0x8C, 0x69, 0x12, 0xB0, 0xC0,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 0xFF, 0x01};
const uint8_t spSIX[] PROGMEM = {0x04, 0xF8, 0xB9, 0x55, 0x01, 0xBF, 0xA5, 0x1B, 0xE0, 0x37, 0x0F, 0x03, 0xFC,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 0xFC, 0x3F};
const uint8_t spSEVEN[] PROGMEM = {0x0C, 0x78, 0xC6, 0x95, 0x01, 0x3F, 0xA5, 0x28, 0xE0, 0xB7, 0x52, 0x0B, 0x04,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 0xFF, 0x07};
const uint8_t spEIGHT[] PROGMEM = {0xAD, 0x1B, 0xDE, 0x58, 0x23, 0x17, 0xAF, 0x6E, 0xE8, 0x20, 0xEB, 0x5C, 0xBC,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 0xFF, 0x0F};
const uint8_t spNINE[] PROGMEM = {0x62, 0x75, 0xDC, 0x33, 0xB5, 0x62, 0xB9, 0x25, 0x0B, 0x8E, 0x34, 0x8F, 0xD3,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 0xFF, 0x03};
const uint8_t spTHE[] PROGMEM = {0x08, 0x20, 0xBA, 0x0D, 0x03, 0x69, 0xDF, 0xA8, 0xCD, 0x85, 0x3B, 0xD7, 0x79, 0xF4, 0x59, 0xB7, 0xA9, 0xFA, 0xA2, 0xD5, 0x27, 0xD9, 0x6E, 0x11, 0x8B, 0xC6, 0x90, 0xB4, 0x47, 0xA8, 0x6D, 0xFA, 0x7F};
const uint8_t spAREA[] PROGMEM = {0xA5, 0xAF, 0x89, 0x35, 0xB2, 0x6B, 0xAF, 0xAE, 0xFB, 0x62, 0x6E, 0xDB, 0xBC,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 0xFF, 0x03};
const uint8_t spIS[] PROGMEM = {0xA3, 0xED, 0xC6, 0x30, 0x3D, 0x57, 0xAD, 0x7E, 0xA8, 0x42, 0xA9, 0x5C, 0xB5,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 0xFF, 0x07};
const uint8_t spPOINT[] PROGMEM = {0x0A, 0xC8, 0x2E, 0x8C, 0x01, 0xD1, 0x85, 0x95, 0x34, 0x8B, 0xAA, 0x74, 0x56,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 0xFB, 0x7F};

Talkie voice;

// Initializing of global varibles 
uint8_t agol_za_sledno_vrtenje;

// Initializing of parameters
void setup() {

  // Initialize motor supply
  pinMode (11, INPUT);
  pinMode (12, OUTPUT);

  // Initialize all four poles of the motor
  pinMode (4, OUTPUT);
  pinMode (5, OUTPUT);
  pinMode (6, OUTPUT);
  pinMode (7, OUTPUT);

  // Initializion of push button
  pinMode (8, INPUT);

  Serial.begin(9600);
}

// Functions

void vrti(); // Rotate the motor
uint8_t measure(); // Calculate the distance betwen the ultrasound sensor and the wall
uint8_t najkratko_rastojanie(); // Find the distance which is 0 degree with the respect to the sensor (smallest distance) 
void sort(uint8_t register niza[], uint8_t register niza_index[]); // Sorting elements, also sorts their indexes
void swap(uint8_t register *a, uint8_t register *b, uint8_t register *index_1, uint8_t register *index_2); // Changes places(subfuction of sort()) 

// Main Program

void loop() {

  // Inicializing of variables
  uint8_t register brojac = 0, k = 0, niza[7];
  float register a, b, c, d, plostina;

  uint8_t x = digitalRead(8); // Inicializing the push button to variable

  if (x == LOW) // If the push button is pressed (LOW) start the program
  {
    delay(5000);

    // Area Measurment

    a = najkratko_rastojanie() * cos(0.0244346); // Correction because of error in the function: najkratko_rastojanie(), on every other side of the angle the correction increments 

    while (brojac < agol_za_sledno_vrtenje) // Rotate the motor for known angle so it gets to the smallest distance 
    {
      vrti();
      brojac++;
    }
    b = measure() * cos(0.06440265);
    brojac = 0;

    while (brojac < 128) // Rotate the motor for 90 degree to find the third smallest distance 
    {
      vrti();
      brojac++;
    }
    c = measure() * cos(0.0890118);
    brojac = 0;

    while (brojac < 128) // Rotate the motor again for 90 degree to find the fourth smallest distance  
    {
      vrti();
      brojac++;
    }
    d = measure() * cos(0.115192) ;

    plostina = (a + c) * (b + d) + 56; // Calculate the area and adds 56 cm^2 because of the are of the used arduino area 
    // If you use different device to calculate the area, be sure to change 56 cm^2

    // Аlgorithm for number separation from the area value
    while (k < 4) // Because the area is converted to meters, only 4 decima numbres are represented, so the counter k < 4 
    {
      niza[k] = (int)plostina % 10; // Seperate the last number from the whole number and append to the array
      plostina /= 10; // Devide the area
      k++;
    }
    niza[k] = 10; // Number which is used to trigger the function voice.say(spPOINT)
    k++;
    niza[k] = (int)plostina; // Appending the last number which must be with one place 

    //  Pronunciation of the area, delay(200) is used for more clearly pronunciation
    voice.say(spTHE);
    delay(200);
    voice.say(spAREA);
    delay(200);
    voice.say(spIS);

    // Pronunciation of the numbers, beggining with the last element, because that element was on that position firstly
    for (brojac = k + 1; brojac > 0; brojac--)
    {
      delay(200);
      switch (niza[brojac - 1]) {
        case 0: voice.say(spZERO);
          break;
        case 1: voice.say(spONE);
          break;
        case 2: voice.say(spTWO);
          break;
        case 3: voice.say(spTHREE);
          break;
        case 4: voice.say(spFOUR);
          break;
        case 5: voice.say(spFIVE);
          break;
        case 6: voice.say(spSIX);
          break;
        case 7: voice.say(spSEVEN);
          break;
        case 8: voice.say(spEIGHT);
          break;
        case 9: voice.say(spNINE);
          break;
        case 10: voice.say(spPOINT);
          break;
      }
    }
  }
}

// Function Codes

void vrti()
{
  // Writes all motor poles; energize one pole, than enegrize the next pole, than deenergize the previous pole and energize the next pole, repeat
  digitalWrite(5, HIGH);
  delayMicroseconds(1000);

  digitalWrite(4, LOW);
  delayMicroseconds(1000);

  digitalWrite(6, HIGH);
  delayMicroseconds(1000);

  digitalWrite(5, LOW);
  delayMicroseconds(1000);

  digitalWrite(7, HIGH);
  delayMicroseconds(1000);

  digitalWrite(6, LOW);
  delayMicroseconds(1000);

  digitalWrite(4, HIGH);
  delayMicroseconds(1000);

  digitalWrite(7, LOW);
  delayMicroseconds(1000);
}


uint8_t measure()
{
  uint16_t register rastojanie;
  digitalWrite (12, LOW);
  delayMicroseconds (2);
  digitalWrite (12, HIGH);
  delayMicroseconds (10);
  digitalWrite (12, LOW);
  delayMicroseconds (2);
  rastojanie = pulseIn (11, HIGH);
  uint8_t register rastojanie_cm = (rastojanie) / 58;
  return rastojanie_cm;
}

void swap(uint8_t register *a, uint8_t register *b, uint8_t register *index_1, uint8_t register *index_2)
{
  // Element sorting
  uint8_t register temp = *a;
  *a = *b;
  *b = temp;

  // Index sorting
  temp = *index_1;
  *index_1 = *index_2;
  *index_2 = temp;
}

void sort(uint8_t register niza[], uint8_t register niza_index[])
{
  uint8_t register j;
  for (uint8_t register i; i < 2; i++)
    for (j = i + 1; j < 3; j++)
      if (niza[j] > niza[i])
      {
        swap(&niza[i], &niza[j], &niza_index[i], &niza_index[j]);
      }
}

uint8_t najkratko_rastojanie() // Rotates the motor for 9.84 degree and thant rotate 88.6 degree more while calculating the distance at every 9.84 degree
{
  uint8_t register niza[3], niza_index[3], j, f = 0;

  // Appent the array with the frist three measurments 
  for (j = 0; j < 3; j++)
  {
    niza[j] = measure();
    niza_index[j] = j;
    while (f < 14) // Rotate the motor 14 times, 9.84 degree at a time
    {
      vrti();
      f++;
    }
    f = 0; // Reset the counter in charge for counting the motor rotation
  }
  sort(niza, niza_index); // Sort the array in that way, that the highest number (highest distance), which is not usefull, put on 0 index in the array

  // Rotates the motor and measuter till 88.6 degree
  for (j = 3; j < 9; j++)
  {
    // The new measured distance puts on the index 0 place, the place where the highest number is (highes distance), than rotates the motor nad sort again
    niza[0] = measure();
    niza_index[0] = j;
    while (f < 14)
    {
      vrti();
      f++;
    }
    f = 0;
    sort(niza, niza_index);
  }

  agol_za_sledno_vrtenje = niza_index[2] * 14; // Calculate the angle which is required to find the next smallest distance (multiply with 14, because with updating the index, the motor has already rotate for 14 times)

  return niza[2];
}
